## cellular-opta-gateway/main/Kconfig.projbuild
```kconfig
menu "PeakLogic Opta Gateway"

    choice BOARD_VARIANT
        prompt "LilyGO board"
        default BOARD_T_ETH_ELITE_A7670X
        help
            T-ETH-ELITE-A7670X is the integrated SKU (W5500 + A7670 on one board).
            Stacked = T-ETH-Elite mainboard + LTE shield + T-PCIE A7670 module.
            GPIO map is identical; integrated board needs GPS-mux init on GPIO4.

        config BOARD_T_ETH_ELITE_A7670X
            bool "T-ETH-ELITE-A7670X (integrated)"
        config BOARD_T_ETH_ELITE_STACKED
            bool "T-ETH-Elite + LTE shield (stacked)"
    endchoice

    config DEVCFG_WIFI_AP_SSID_DEFAULT
        string "Setup AP SSID"
        default "PeakLogic-Gateway"

    config DEVCFG_WIFI_AP_PASS_DEFAULT
        string "Setup AP password (min 8 chars)"
        default "peaklogic"

    config DEVCFG_WIFI_AP_HTTP_PORT
        int "Setup HTTP port on AP (192.168.4.1)"
        default 8080
        range 80 65535

    config DEVCFG_LOCAL_MQTT_PORT_DEFAULT
        int "Local MQTT broker port (Opta connects here)"
        default 1883
        range 1 65535

    config DEVCFG_LAN_IP_DEFAULT
        string "LAN IP (W5500 / Opta side)"
        default "192.168.1.1"

    config DEVCFG_LAN_MASK_DEFAULT
        string "LAN netmask"
        default "255.255.255.0"

    config DEVCFG_CLOUD_MQTT_HOST_DEFAULT
        string "Cloud MQTT broker host (droplet public IP)"
        default "127.0.0.1"

    config DEVCFG_CLOUD_MQTT_PORT_DEFAULT
        int "Cloud MQTT broker port"
        default 1883
        range 1 65535

    config DEVCFG_MODEM_APN_DEFAULT
        string "Cellular APN"
        default "teal"
        help
            Simetry/Teal Smart SIM default APN. Use meerkat.teal on Meerkat platform,
            or your private APN if Simetry assigned one.

    config GATEWAY_WAN_WIFI_FALLBACK
        bool "Bench: use Wi-Fi STA as WAN instead of LTE modem"
        default n
        help
            For development without the LTE shield. Connect to office Wi-Fi
            with menuconfig WAN Wi-Fi SSID/password. Production: disable.

    config GATEWAY_WAN_WIFI_SSID
        string "Bench WAN Wi-Fi SSID"
        depends on GATEWAY_WAN_WIFI_FALLBACK
        default "mywifi"

    config GATEWAY_WAN_WIFI_PASS
        string "Bench WAN Wi-Fi password"
        depends on GATEWAY_WAN_WIFI_FALLBACK
        default ""

endmenu

menu "T-ETH-Elite W5500 (SPI Ethernet LAN)"

    comment "LilyGO T-ETH-Elite defaults (LilyGO-T-ETH-Series utilities.h)"

    config ETH_LAN_ENABLE
        bool "Enable W5500 LAN for Opta"
        default y

    config ETH_W5500_SPI_HOST
        int "SPI host (SPI2_HOST=1, SPI3_HOST=2)"
        default 2

    config ETH_W5500_SPI_MOSI
        int "SPI MOSI GPIO"
        default 21

    config ETH_W5500_SPI_MISO
        int "SPI MISO GPIO"
        default 47

    config ETH_W5500_SPI_SCLK
        int "SPI SCLK GPIO"
        default 48

    config ETH_W5500_SPI_CS
        int "SPI CS GPIO"
        default 45

    config ETH_W5500_INT_GPIO
        int "W5500 INT GPIO (-1 = poll mode)"
        default 14

    config ETH_W5500_POLL_MS
        int "W5500 poll period ms (0 = interrupt mode when INT wired)"
        default 0

    config ETH_W5500_SPI_MHZ
        int "SPI clock MHz"
        default 20
        range 1 40

endmenu

menu "LTE modem (A7670 — T-ETH-ELITE-A7670X or stacked shield)"

    comment "UART: ESP TX=GPIO6, RX=GPIO4, PWRKEY=GPIO3 (LilyGO pin map)"

    config MODEM_LTE_ENABLE
        bool "Enable A7670 cellular WAN (esp_modem PPP)"
        default y
        depends on !GATEWAY_WAN_WIFI_FALLBACK

    config MODEM_UART_PORT
        int "UART port for modem"
        default 1
        range 0 2

    config MODEM_UART_TX_GPIO
        int "Modem UART TX (ESP -> modem RX)"
        default 6

    config MODEM_UART_RX_GPIO
        int "Modem UART RX (ESP <- modem TX)"
        default 4

    config MODEM_PWRKEY_GPIO
        int "Modem PWRKEY GPIO"
        default 3

    config MODEM_DTR_GPIO
        int "Modem DTR GPIO (-1 = unused)"
        default 5

    config MODEM_UART_BAUD
        int "Modem UART baud rate"
        default 115200

    config MODEM_PWRON_PULSE_MS
        int "PWRKEY low pulse duration (ms)"
        default 1000
        range 100 3000

    config MODEM_GPS_ENABLE_GPIO
        int "GPS enable GPIO (integrated A7670X only, GPIO4)"
        depends on BOARD_T_ETH_ELITE_A7670X
        default 4

    config MODEM_GPS_ENABLE_LEVEL
        int "GPS enable active level (integrated; use inverse for UART/data)"
        depends on BOARD_T_ETH_ELITE_A7670X
        default 0
        range 0 1

endmenu

menu "Board extras"

    config BOARD_STATUS_LED_GPIO
        int "Status LED GPIO (T-ETH-Elite LED on GPIO38)"
        default 38
        range -1 48

endmenu
```

## halow-xiao-sta/main/Kconfig.projbuild
```kconfig
menu "LilyGO T-HaLow (TX-AH) Configuration"

    comment "MQTT uses HaLow (raw Ethernet via TX-AH). Wi-Fi AP is setup-only."

    config TX_AH_UART_PORT
        int "UART port for TX-AH module"
        default 1
        range 0 2

    config TX_AH_UART_TX_GPIO
        int "TX-AH UART TX GPIO (ESP32 -> module RX)"
        default 4

    config TX_AH_UART_RX_GPIO
        int "TX-AH UART RX GPIO (ESP32 <- module TX)"
        default 5

    config TX_AH_UART_BAUD
        int "TX-AH UART baud rate"
        default 115200

    config TX_AH_AT_TIMEOUT_MS
        int "AT command response timeout (ms)"
        default 3000
        range 500 30000

    config TX_AH_BSS_BW_STR
        string "BSS bandwidth (1/2/4/8)"
        default "8"

    config TX_AH_USE_PAIRING
        bool "Use AT+PAIR pairing (recommended for LilyGO AP/STA workflow)"
        default y
        help
            When enabled, firmware sends AT+PAIR=1 and waits for PAIR SUCCESS.
            Put the HaLow AP in pairing mode at the same time (see LilyGO docs).
            Disable to use manual SSID + PSK below.

    config TX_AH_PAIR_TIMEOUT_MS
        int "Pairing / connect wait timeout (ms)"
        default 30000
        range 5000 120000

    config HALOW_SSID
        string "HaLow AP SSID (manual mode only)"
        depends on !TX_AH_USE_PAIRING
        default "hgic_ah_test"

    config HALOW_PSK_HEX
        string "HaLow WPA PSK as 64 hex chars (manual mode, or empty for open)"
        depends on !TX_AH_USE_PAIRING
        default ""

endmenu

menu "Device config (NVS defaults + setup AP)"

    config DEVCFG_MQTT_BROKER_DEFAULT
        string "Default MQTT broker host (HaLow/LAN reachable IP)"
        default "10.10.10.1"

    config DEVCFG_MQTT_PORT_DEFAULT
        int "Default MQTT broker port"
        default 1883
        range 1 65535

    config DEVCFG_HALOW_IP_DEFAULT
        string "Default HaLow static IP"
        default "10.10.10.2"

    config DEVCFG_HALOW_GW_DEFAULT
        string "Default HaLow gateway"
        default "10.10.10.1"

    config DEVCFG_HALOW_MASK_DEFAULT
        string "Default HaLow netmask"
        default "255.255.255.0"

    config DEVCFG_WIFI_AP_SSID_DEFAULT
        string "Wi-Fi setup AP SSID"
        default "PeakLogic-T-HaLow"

    config DEVCFG_WIFI_AP_PASS_DEFAULT
        string "Wi-Fi setup AP password (8+ chars)"
        default "peaklogic"

    config DEVCFG_WIFI_AP_HTTP_PORT
        int "Setup HTTP port on Wi-Fi AP"
        default 8080
        range 80 65535

    config DEVCFG_SENSOR_TEMPLATE_DEFAULT
        int "Default ALF sensor template (1-6)"
        default 1
        range 1 6

endmenu



menu "PeakLogic Parc (MQTT) Configuration"



    config PARC_MQTT_BROKER_URI

        string "MQTT broker URI (same broker the Opta + PeakLogic use)"

        default "mqtt://192.168.1.233:1883"



    config PARC_DEVICE_ID

        string "Parc device ID (deviceId + topic path segment)"

        default "thalow_01"



    config PARC_DEVICE_NAME

        string "Human-readable device name (telemetry \"name\")"

        default "LilyGO T-HaLow Node"



    choice PARC_DEVICE_MODE

        prompt "Parc device mode (telemetry \"deviceMode\")"

        default PARC_DEVICE_MODE_STANDALONE



        config PARC_DEVICE_MODE_STANDALONE

            bool "standalone"



        config PARC_DEVICE_MODE_REMOTE_IO

            bool "remote_io"

    endchoice



    config PARC_TOPIC_PREFIX

        string "Parc topic prefix"

        default "peaklogic/v1"



    config PARC_GLOBAL_SITE_KEY

        int "Global (P2P) site key 1..65535"

        default 1

        range 1 65535



    config PARC_MQTT_USERNAME

        string "MQTT username (leave empty for anonymous)"

        default ""



    config PARC_MQTT_PASSWORD

        string "MQTT password (leave empty for none)"

        default ""



    config PARC_PUBLISH_INTERVAL_MS

        int "Telemetry report interval (ms)"

        default 2000

        range 250 600000



endmenu



menu "Sensors (ALF templates — global tuning)"

    comment "I/O layout is selected on /setup (ALF templates 1-6)."
    comment "Reserved GPIO: 4/5 HaLow UART, 38 LED, 39-42 SPI."

    config SENS_THERM_BETA
        int "NTC thermistor beta (e.g. 3950)"
        default 3950

    config SENS_THERM_R0_OHM
        int "NTC R0 at 25C (ohms)"
        default 10000

    config SENS_THERM_RS_OHM
        int "Thermistor series resistor (ohms)"
        default 10000

    config SENS_CT_AMPS_PER_VOLT_X1000
        int "CT scale: amps per volt RMS x1000 (SCT-013-030 = 30000)"
        default 30000

    config SENS_CT_SAMPLES
        int "ADC samples per CT RMS window"
        default 1200
        range 200 4000

    config SENS_FLOW_GLITCH_NS
        int "Pulse PCNT glitch filter (ns, 0 = off)"
        default 2000

    config SENS_LEAK_LATCH
        bool "Latch leak rope alarms until MQTT reset"
        default y

    config SENS_LEAK_FILTER_ALPHA_X1000
        int "Leak EMA filter alpha x1000 (0 = off, 100 = 0.10)"
        default 100
        range 0 1000

    config SENS_TASK_PERIOD_MS
        int "Sensor sampling period (ms)"
        default 1000
        range 200 60000

endmenu
```
